## security/hardening/build/debian-build/hardening-lsm-1.0.0/debian/hardening-lsm/usr/src/hardening-lsm-1.0.0/Kconfig
```kconfig
# SPDX-License-Identifier: GPL-2.0-only
config SECURITY_HARDENING
	bool "Security Hardening Module"
	depends on SECURITY
	select SECURITYFS
	select CRYPTO
	select CRYPTO_SHA256
	default n
	help
	  This enables the Security Hardening Module which provides
	  innovative security controls including:
	  - Temporal access control (time-based policies)
	  - ML-inspired behavioral anomaly detection
	  - Resource usage fingerprinting
	  - Adaptive security levels
	  - Process lineage tracking
	  - Container-aware policies
	  
	  The module can be configured at runtime through securityfs.

	  If you are unsure how to answer this question, answer N.

if SECURITY_HARDENING

config SECURITY_HARDENING_TEMPORAL
	bool "Temporal Access Control"
	default y
	help
	  Enable time-based access control policies. This allows
	  restricting process operations to specific time windows
	  (hours of day, days of week).

config SECURITY_HARDENING_BEHAVIOR
	bool "Behavioral Anomaly Detection"
	default y
	help
	  Enable ML-inspired behavioral anomaly detection using
	  n-gram analysis, Markov chains, and pattern recognition
	  to detect unusual process behavior.

config SECURITY_HARDENING_BEHAVIOR_WINDOW
	int "Behavior analysis window size"
	depends on SECURITY_HARDENING_BEHAVIOR
	default 128
	range 32 1024
	help
	  Number of syscalls to track in behavioral analysis window.
	  Larger values provide better accuracy but use more memory.

config SECURITY_HARDENING_RESOURCES
	bool "Resource Usage Fingerprinting"
	default y
	help
	  Enable resource usage fingerprinting to detect abnormal
	  resource consumption patterns that may indicate compromise.

config SECURITY_HARDENING_ADAPTIVE
	bool "Adaptive Security Levels"
	default y
	help
	  Enable dynamic security level adjustment based on detected
	  threats. Security restrictions automatically escalate when
	  anomalies are detected.

config SECURITY_HARDENING_LINEAGE
	bool "Process Lineage Tracking"
	default y
	help
	  Track full process ancestry to detect suspicious process
	  chains and inheritance of security contexts.

config SECURITY_HARDENING_CONTAINER
	bool "Container-Aware Security"
	depends on CGROUPS
	default y
	help
	  Enable container-specific security policies and isolation
	  mechanisms for containerized workloads.

config SECURITY_HARDENING_NETWORK
	bool "Network Behavior Profiling"
	depends on SECURITY_NETWORK
	default y
	help
	  Enable network behavior profiling to detect unusual
	  network access patterns and connection attempts.

config SECURITY_HARDENING_MEMORY
	bool "Memory Access Pattern Analysis"
	default y
	help
	  Analyze memory access patterns to detect exploitation
	  attempts like ROP chains and heap spraying.

config SECURITY_HARDENING_CRYPTO
	bool "Cryptographic Integrity"
	depends on CRYPTO
	default y
	help
	  Use cryptographic hashes to verify process and file
	  integrity throughout execution.

config SECURITY_HARDENING_ENTROPY
	bool "Entropy-Based Randomization"
	default y
	help
	  Add entropy-based randomization to security decisions
	  to make attacks less predictable.

config SECURITY_HARDENING_PROFILES
	bool "Per-Process Security Profiles"
	default y
	help
	  Support loading and enforcing per-process security
	  profiles from userspace.

config SECURITY_HARDENING_PROFILES_MAX
	int "Maximum security profiles"
	depends on SECURITY_HARDENING_PROFILES
	default 1024
	range 64 8192
	help
	  Maximum number of security profiles that can be loaded.

config SECURITY_HARDENING_SYSCALL_FILTER
	bool "Advanced Syscall Filtering"
	default y
	help
	  Enable advanced syscall filtering with pattern matching
	  and argument inspection capabilities.

config SECURITY_HARDENING_DEBUG
	bool "Debug output"
	default n
	help
	  Enable debug output from the hardening module.
	  This should only be enabled for development.

config SECURITY_HARDENING_STATS
	bool "Statistics collection"
	default y
	help
	  Collect detailed statistics about security events,
	  anomalies, and policy violations.

endif # SECURITY_HARDENING
```
